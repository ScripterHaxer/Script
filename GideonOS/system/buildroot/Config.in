## GideonOS/system/buildroot/Config.in
```kconfig
menu "GideonOS"
source "$BR2_EXTERNAL_GIDEONOS_PATH/package/gideon-compositor/Config.in"
source "$BR2_EXTERNAL_GIDEONOS_PATH/package/gideon-gfx-probe/Config.in"
endmenu
```

## GideonOS/system/buildroot/package/gideon-compositor/Config.in
```kconfig
config BR2_PACKAGE_GIDEON_COMPOSITOR
	bool "gideon-compositor"
	depends on BR2_PACKAGE_HOST_RUSTC_TARGET_ARCH_SUPPORTS
	depends on BR2_PACKAGE_SYSTEMD # udev, logind (libseat backend)
	depends on BR2_PACKAGE_MESA3D # libgbm
	select BR2_PACKAGE_HOST_RUSTC
	select BR2_PACKAGE_WAYLAND
	select BR2_PACKAGE_LIBINPUT
	select BR2_PACKAGE_LIBXKBCOMMON
	select BR2_PACKAGE_XKEYBOARD_CONFIG
	select BR2_PACKAGE_PIXMAN
	select BR2_PACKAGE_SEATD
	select BR2_PACKAGE_LIBDRM
	select BR2_PACKAGE_MESA3D_GBM
	help
	  The GideonOS Wayland compositor (components/compositor):
	  DRM/KMS output, libinput input, window management,
	  workspaces and an IPC socket for the desktop shell.
```

## GideonOS/system/buildroot/package/gideon-gfx-probe/Config.in
```kconfig
config BR2_PACKAGE_GIDEON_GFX_PROBE
	bool "gideon-gfx-probe"
	depends on BR2_PACKAGE_WAYLAND
	depends on BR2_PACKAGE_HAS_LIBEGL && BR2_PACKAGE_HAS_LIBGLES
	select BR2_PACKAGE_WAYLAND_PROTOCOLS
	help
	  Wayland test client used by the GideonOS graphics tests:
	  draws a known colour via wl_shm or EGL/GLES2 and reacts to
	  keyboard and pointer input (components/gfx-probe).
```
